VERSION ""

NS_ :

BS_:

BU_: VEHICLE

BO_ 881 THROTTLE_PRESSURE: 8 VEHICLE
 SG_ THROTTLE_PRESSURE : 56|8@1+ (0.393,0) [0|0] "bar" VEHICLE

BO_ 544 BRAKE_PRESSURE: 8 VEHICLE
 SG_ BRAKE_PRESSURE : 24|12@1+ (0.033,0) [0|0] "bar" VEHICLE

BO_ 688 STEERING_ANGLE: 8 VEHICLE
 SG_ STEERING_WHEEL_ANGLE : 0|16@1- (0.018,0) [0|0] "degrees" VEHICLE

BO_ 1322 SPEED: 8 VEHICLE
 SG_ SPEED : 0|8@1+ (0.3,0) [0|0] "mps" VEHICLE

CM_ BO_ 881 "Vehicle Throttle Pressure";
CM_ BO_ 544 "Vehicle Brake Pressure";
CM_ BO_ 688 "Vehicle Steering Angle";
CM_ BO_ 1322 "Vehicle Speed";
